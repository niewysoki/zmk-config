/ {
    combos {
        compatible = "zmk,combos";

        combo_qwerty {
			timeout-ms = <50>;
			key-positions = <0 3>;
			bindings = <&to 7>;
			layers = <0>;
		};

		combo_base {
			timeout-ms = <50>;
			key-positions = <0 3>;
			bindings = <&to 0>;
			layers = <7>;
		};
    };
};