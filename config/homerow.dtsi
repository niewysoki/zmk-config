/ {
	behaviors {
		hm: homerow_mods {
			compatible = "zmk,behavior-hold-tap";
			label = "HOMEROW MODS";
			#binding-cells = <2>;
			tapping_term_ms = <150>;
			quick_tap_ms = <0>;
			flavor = "tap-preferred";
			bindings = <&kp>, <&kp>;
		};

		bhm: balanced_homerow_mods {
			compatible = "zmk,behavior-hold-tap";
			label = "BALANCED_HOMEROW_MODS";
			#binding-cells = <2>;
			tapping-term-ms = <200>;
			quick_tap_ms = <0>;
			flavor = "balanced";
			bindings = <&kp>, <&kp>;
		};
	};
};