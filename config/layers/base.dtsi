#include <dt-bindings/zmk/keys.h>
#include "homerow.dtsi"


&base_bindings = <
// TOP LEFT (0 - 5)
    &none 
    &kp Q &kp W &kp F &kp P &kp B 

// TOP RIGHT (6 - 11)
    &kp J &kp L &kp U &kp Y &kp SQT 
    &none

// MIDDLE LEFT (12 - 17)
    &none 
    &hm LGUI A &hm LALT R &hm LCTL S &hm LSHFT T &kp G

// MIDDLE RIGHT (18 - 23)
    &kp M &hm LSHFT N &hm LCTL E &hm LALT I &hm LGUI O 
    &none

// BOTTOM LEFT (24 - 29)
    &none 
    &kp Z &kp x &kp C &kp D &kp V

// UPPER THUMB LEFT - RIGHT (30 - 33)
    &kp LSHFT &kp LSHFT &kp LSHFT &kp LSHFT

// BOTTOM RIGHT (34 - 39)
    &kp K &kp H &kp COMMA &kp DOT &kp FSLH 
    &none

// THUMB LEFT (40 - 44)
    &kp LSHFT &kp RALT &kp ESC &kp SPACE &kp TAB

// THUMB RIGHT (45 - 49)
    &kp RET &kp BSPC &kp DEL &kp RALT &kp LSHFT
>;

&base_sensor_bindings = <
// LEFT ENCODER
    &inc_dec_kp PG_UP PG_DN 
// RIGHT ENCODER
    &inc_dec_kp PG_UP PG_DN
>;