\ {
    combos {
        compatible = "zmk,combos";

        combo_qwerty {
			timeout-ms = <50>;
			key-positions = <1 2 3 4>;
			bindings = <&to 7>;
			layers = <0>;
		};

		combo_base {
			timeout-ms = <50>;
			key-positions = <1 2 3 4>;
			bindings = <&to 0>;
			layers = <7>;
		};
    }
}