/ {
	keymap {
		NUM_LAYER {
			label = "Numbers";
			bindings = <
                &kp LBKT    &kp NUM_7   &kp NUM_8   &kp NUM_9   &kp RBKT    &none       &none       &none       &none       &bootloader 
                &kp SEMI    &kp NUM_4   &kp NUM_5   &kp NUM_6   &kp EQUAL   &none       &kp LSHFT   &kp LCTL    &kp LALT    &kp LGUI
                &kp GRAVE   &kp NUM_1   &kp NUM_2   &kp NUM_3   &kp BSLH    &none       &none       &none       &kp RALT    &none 
                                        &kp DOT     &kp NUM_0   &kp MINUS   &none       &none       &none
			>;
		};	
	};
};

