/ {
	keymap {
		BLE_LAYER {
			label = "Bluetooth";
			bindings = <
            // TOP ROW - keys 0 to 9
                &none       &none       &none       &none       &bootloader
                &none       &none       &none       &none       &kp BT_CLR 

            // MIDDLE ROW - keys 10 to 19
                &kp LGUI     &kp LALT     &kp LCTL     &kp LSHFT    &none     
                &kp BT_SEL 0 &kp BT_SEL 1 &kp BT_SEL 2 &kp BT_SEL 3 &kp BT_SEL 4 

            // BOTTOM ROW - keys 20 to 29
                &none       &kp RALT    &none       &none       &none 
                &none       &none       &none       &none       &none

            // THUMB ROW - keys 30 to 36
                &kp RET     &kp BSPC    &kp DEL
                &none       &none       &none
			>;
		};	
	};
};
