// TODO split media layer into media and bluetooth layers

/ {
	keymap {
		MED_LAYER {
			label = "Media";
			bindings = <
            // TOP ROW - keys 0 to 9
                &bootloader  &none        &none        &none       &none
                &kp BT_SEL 0 &kp BT_SEL 1 &kp BT_SEL 2 &kp BT_SEL 3 &kp BT_SEL 4 

            // MIDDLE ROW - keys 10 to 19
                &kp LGUI     &kp LALT   &kp LCTL    &kp LSHFT    &none     
                &out OUT_TOG &kp C_PREV &kp C_VOL_D &kp C_VOL_UP &kp C_NEXT


            // BOTTOM ROW - keys 20 to 29
                &none &kp RALT   &none    &none      &none 
                &none &kp C_STOP &kp C_PP &kp C_MUTE &kp BT_CLR


            // THUMB ROW - keys 30 to 36
                &kp RET &kp BSPC &kp DEL
                &none   &none    &none
			>;
		};	
	};
};