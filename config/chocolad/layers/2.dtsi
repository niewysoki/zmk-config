/ {
	keymap {
		NAV_LAYER {
			label = "Navigation";
			bindings = <
                &none       &none       &none       &none       &bootloader &none       &none       &none       &none       &kp BT_CLR 
                &kp LGUI    &kp LALT    &kp LCTL    &kp LSHFT   &none       &kp CPAS    &kp LEFT    &kp DOWN    &kp UP      &kp RIGHT
                &none       &kp RALT    &none       &none       &none       &kp INS     &kp HOME    &kp PG_DN   &kp PG_UP   &kp END
                                        &kp RET     &kp BSPC    &kp DEL     &none       &none       &none
			>;
		};	
	};
};

