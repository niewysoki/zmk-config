/ {
	keymap {
		MED_LAYER {
			label = "Media";
			bindings = <
                &none       &none       &none       &none       &bootloader &none       &none       &none       &none       &kp BT_CLR 
                &kp LGUI    &kp LALT    &kp LCTL    &kp LSHFT   &none       &out OUT_TOG &kp C_PREV &kp C_VOL_D &kp C_VOL_UP &kp C_NEXT
                &none       &kp RALT    &none       &none       &none       &none       &kp C_STOP  &kp C_PP    &kp C_MUTE  &none
                                                    &kp RET     &kp BSPC    &kp DEL     &none       &none       &none
			>;
		};	
	};
};

