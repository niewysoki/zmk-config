
/ {
	keymap {
		BLE_LAYER {
			label = "Bluetooth";
			bindings = <
                &none       &none       &none       &none       &bootloader &none       &none       &none       &none       &kp BT_CLR 
                &kp LGUI    &kp LALT    &kp LCTL    &kp LSHFT   &none       &kp BT_SEL 0&kp BT_SEL 1&kp BT_SEL 2&kp BT_SEL 3&kp BT_SEL 4 
                &none       &kp RALT    &none       &none       &none       &none       &none       &none       &none       &none
                                        &kp RET     &kp BSPC    &kp DEL     &none       &none       &none
			>;
		};	
	};
};

