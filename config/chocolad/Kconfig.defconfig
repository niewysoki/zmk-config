## config/chocolad/Kconfig.defconfig
```kconfig
# Copyright (c) 2021 The ZMK Contributors
# SPDX-License-Identifier: MIT

if SHIELD_CHOCOLAD_LEFT

config ZMK_KEYBOARD_NAME
	default "Chocolad"

config ZMK_SPLIT_BLE_ROLE_CENTRAL
	default y
	
endif

if SHIELD_CHOCOLAD_LEFT || SHIELD_CHOCOLAD_RIGHT

config ZMK_SPLIT
	default y

endif
```
